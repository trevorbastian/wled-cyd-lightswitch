#include "settings.h"

#include <ArduinoJson.h>
#include <Preferences.h>

#include "default_config.h"  // generated by scripts/embed_config.py

static const char *NVS_NAMESPACE = "wledremote";
static const char *KEY_CONFIG = "config";
static const char *KEY_SEED = "seed";

Settings settings;

static void fromJson(const char *json, Settings &s) {
    s = Settings();

    JsonDocument doc;
    if (deserializeJson(doc, json)) {
        Serial.println("settings: invalid JSON, using defaults");
        return;
    }

    s.ssid = String(doc["wifi"]["ssid"] | "").substring(0, SSID_MAX_LEN);
    s.password = String(doc["wifi"]["password"] | "").substring(0, PASSWORD_MAX_LEN);

    for (JsonObject light : doc["lights"].as<JsonArray>()) {
        if (s.numLights >= MAX_LIGHTS) break;
        String host = light["host"] | "";
        if (host.isEmpty()) continue;
        LightConfig &l = s.lights[s.numLights++];
        l.host = host.substring(0, HOST_MAX_LEN);
        l.name = String(light["name"] | host.c_str()).substring(0, NAME_MAX_LEN);
    }

    JsonObject touch = doc["touch"];
    if (touch["x_min"].is<int>() && touch["x_max"].is<int>() &&
        touch["y_min"].is<int>() && touch["y_max"].is<int>()) {
        s.hasTouchCal = true;
        s.touch.xMin = touch["x_min"];
        s.touch.xMax = touch["x_max"];
        s.touch.yMin = touch["y_min"];
        s.touch.yMax = touch["y_max"];
    }
}

static String toJson(const Settings &s) {
    JsonDocument doc;
    if (!s.ssid.isEmpty()) {
        doc["wifi"]["ssid"] = s.ssid;
        doc["wifi"]["password"] = s.password;
    }
    JsonArray lights = doc["lights"].to<JsonArray>();
    for (size_t i = 0; i < s.numLights; i++) {
        JsonObject l = lights.add<JsonObject>();
        l["name"] = s.lights[i].name;
        l["host"] = s.lights[i].host;
    }
    if (s.hasTouchCal) {
        doc["touch"]["x_min"] = s.touch.xMin;
        doc["touch"]["x_max"] = s.touch.xMax;
        doc["touch"]["y_min"] = s.touch.yMin;
        doc["touch"]["y_max"] = s.touch.yMax;
    }
    String out;
    serializeJson(doc, out);
    return out;
}

void settingsLoad() {
    Preferences prefs;
    prefs.begin(NVS_NAMESPACE, true);
    String seed = prefs.getString(KEY_SEED, "");
    String stored = prefs.getString(KEY_CONFIG, "");
    prefs.end();

    if (seed != DEFAULT_CONFIG_HASH || stored.isEmpty()) {
        // First boot, or a different config.json has been flashed
        Serial.printf("settings: applying flashed defaults (%s)\n", DEFAULT_CONFIG_HASH);
        settingsFactoryReset();
    } else {
        fromJson(stored.c_str(), settings);
    }
}

void settingsSave() {
    Preferences prefs;
    prefs.begin(NVS_NAMESPACE, false);
    prefs.putString(KEY_CONFIG, toJson(settings));
    prefs.putString(KEY_SEED, DEFAULT_CONFIG_HASH);
    prefs.end();
}

void settingsFactoryReset() {
    fromJson(DEFAULT_CONFIG_JSON, settings);
    settingsSave();
}

bool settingsAddLight(const String &name, const String &host) {
    if (settings.numLights >= MAX_LIGHTS) return false;
    LightConfig &l = settings.lights[settings.numLights++];
    l.name = name.substring(0, NAME_MAX_LEN);
    l.host = host.substring(0, HOST_MAX_LEN);
    return true;
}

void settingsRemoveLight(size_t i) {
    if (i >= settings.numLights) return;
    for (size_t j = i; j + 1 < settings.numLights; j++) settings.lights[j] = settings.lights[j + 1];
    settings.numLights--;
    settings.lights[settings.numLights] = LightConfig();
}

void settingsSwapLights(size_t a, size_t b) {
    if (a >= settings.numLights || b >= settings.numLights) return;
    LightConfig tmp = settings.lights[a];
    settings.lights[a] = settings.lights[b];
    settings.lights[b] = tmp;
}

int settingsFindLight(const String &host) {
    for (size_t i = 0; i < settings.numLights; i++) {
        if (settings.lights[i].host.equalsIgnoreCase(host)) return i;
    }
    return -1;
}
