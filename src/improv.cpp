#include "improv.h"

#include <Arduino.h>
#include <vector>

#include "build_info.h"  // generated by scripts/version.py
#include "settings.h"
#include "ui.h"
#include "wifi_mgr.h"

// Packet: "IMPROV" <version 1> <type> <length> <data...> <checksum>, where the
// checksum is the low byte of the sum of all preceding bytes. Packets must
// start at the beginning of a line, so all other serial output ends in '\n'.
static const uint8_t HEADER[] = { 'I', 'M', 'P', 'R', 'O', 'V', 1 };
static const size_t HEADER_LEN = sizeof(HEADER);

enum : uint8_t { TYPE_STATE = 1, TYPE_ERROR = 2, TYPE_RPC = 3, TYPE_RESULT = 4 };
enum : uint8_t { STATE_READY = 2, STATE_PROVISIONING = 3, STATE_PROVISIONED = 4 };
enum : uint8_t { ERR_NONE = 0, ERR_INVALID_RPC = 1, ERR_UNKNOWN_COMMAND = 2, ERR_UNABLE_TO_CONNECT = 3 };
enum : uint8_t { CMD_WIFI_SETTINGS = 1, CMD_CURRENT_STATE = 2, CMD_DEVICE_INFO = 3, CMD_SCAN = 4 };

static const uint32_t CONNECT_TIMEOUT_MS = 15000;

static uint8_t rx[HEADER_LEN + 2 + 255 + 1];
static size_t rxLen = 0;

enum Busy { IDLE, CONNECTING, SCANNING };
static Busy busy = IDLE;
static String newSsid, newPassword;
static uint32_t connectStart;

static void sendPacket(uint8_t type, const uint8_t *data, size_t length) {
    uint8_t packet[HEADER_LEN + 2 + 255 + 2];
    size_t n = 0;
    for (uint8_t b : HEADER) packet[n++] = b;
    packet[n++] = type;
    packet[n++] = length;
    memcpy(packet + n, data, length);
    n += length;
    uint8_t sum = 0;
    for (size_t i = 0; i < n; i++) sum += packet[i];
    packet[n++] = sum;
    packet[n++] = '\n';
    Serial.write(packet, n);
}

static void sendState(uint8_t state) {
    sendPacket(TYPE_STATE, &state, 1);
}

static void sendError(uint8_t error) {
    sendPacket(TYPE_ERROR, &error, 1);
}

// RPC result: <command> <total length> then each string as <length> <bytes>
static void sendResult(uint8_t command, const std::vector<String> &strings) {
    uint8_t data[255];
    size_t n = 2;
    for (const String &s : strings) {
        size_t len = min(s.length(), (size_t)(sizeof(data) - n - 1));
        data[n++] = len;
        memcpy(data + n, s.c_str(), len);
        n += len;
    }
    data[0] = command;
    data[1] = n - 2;
    sendPacket(TYPE_RESULT, data, n);
}

static bool isProvisioned() {
    return !settings.ssid.isEmpty() && wifiConnectedTo(settings.ssid);
}

static void startProvisioning(const String &ssid, const String &password) {
    newSsid = ssid;
    newPassword = password;
    busy = CONNECTING;
    connectStart = millis();
    sendError(ERR_NONE);
    sendState(STATE_PROVISIONING);
    wifiConnect(ssid, password);
    uiImprovStarted(ssid);
}

// Reads the length-prefixed SSID and password from a WiFi settings command
static bool parseWifiSettings(const uint8_t *data, size_t length, String &ssid, String &password) {
    if (length < 1 || data[0] > length - 1) return false;
    size_t ssidLen = data[0];
    size_t pos = 1 + ssidLen;
    if (pos >= length || data[pos] > length - pos - 1) return false;
    size_t passLen = data[pos];
    if (ssidLen == 0 || ssidLen > SSID_MAX_LEN || passLen > PASSWORD_MAX_LEN) return false;
    ssid = String((const char *)data + 1, ssidLen);
    password = String((const char *)data + pos + 1, passLen);
    return true;
}

static void handleCommand(uint8_t command, const uint8_t *data, size_t length) {
    switch (command) {
        case CMD_WIFI_SETTINGS: {
            String ssid, password;
            if (!parseWifiSettings(data, length, ssid, password)) {
                sendError(ERR_INVALID_RPC);
                return;
            }
            startProvisioning(ssid, password);
            break;
        }
        case CMD_CURRENT_STATE:
            if (busy == CONNECTING) {
                sendState(STATE_PROVISIONING);
            } else if (isProvisioned()) {
                sendState(STATE_PROVISIONED);
                sendResult(CMD_CURRENT_STATE, {});  // no web page URL to offer
            } else {
                sendState(STATE_READY);
            }
            break;
        case CMD_DEVICE_INFO:
            sendResult(CMD_DEVICE_INFO, { FIRMWARE_NAME, FIRMWARE_VERSION, "ESP32", "WLED Lightswitch" });
            break;
        case CMD_SCAN:
            busy = SCANNING;
            wifiStartScan();
            break;
        default:
            sendError(ERR_UNKNOWN_COMMAND);
            break;
    }
}

static void handlePacket(size_t total) {
    uint8_t sum = 0;
    for (size_t i = 0; i < total - 1; i++) sum += rx[i];
    uint8_t type = rx[HEADER_LEN];
    uint8_t length = rx[HEADER_LEN + 1];
    const uint8_t *data = rx + HEADER_LEN + 2;

    // RPC data: <command> <data length> <data...>
    if (sum != rx[total - 1] || type != TYPE_RPC || length < 2 || data[1] > length - 2) {
        sendError(ERR_INVALID_RPC);
        return;
    }
    if (busy != IDLE && data[0] != CMD_CURRENT_STATE) return;  // one command at a time
    handleCommand(data[0], data + 2, data[1]);
}

static void readSerial() {
    while (Serial.available()) {
        uint8_t b = Serial.read();
        if (rxLen < HEADER_LEN) {
            // Match the header byte by byte, resyncing on anything else
            if (b == HEADER[rxLen]) rx[rxLen++] = b;
            else rxLen = b == HEADER[0] ? (rx[0] = b, 1) : 0;
            continue;
        }
        rx[rxLen++] = b;
        if (rxLen < HEADER_LEN + 2) continue;
        size_t total = HEADER_LEN + 2 + rx[HEADER_LEN + 1] + 1;
        if (rxLen == total) {
            handlePacket(total);
            rxLen = 0;
        }
    }
}

static void checkProgress() {
    if (busy == CONNECTING) {
        if (wifiConnectedTo(newSsid)) {
            settings.ssid = newSsid;
            settings.password = newPassword;
            settingsSave();
            busy = IDLE;
            sendState(STATE_PROVISIONED);
            sendResult(CMD_WIFI_SETTINGS, {});
            uiImprovFinished(true);
        } else if (millis() - connectStart > CONNECT_TIMEOUT_MS) {
            busy = IDLE;
            sendError(ERR_UNABLE_TO_CONNECT);
            sendState(STATE_READY);
            wifiConnectSaved();
            uiImprovFinished(false);
        }
    } else if (busy == SCANNING && wifiScanDone()) {
        busy = IDLE;
        for (const Network &n : wifiScanResults()) {
            sendResult(CMD_SCAN, { n.ssid, String(n.rssi), n.secure ? "YES" : "NO" });
        }
        sendResult(CMD_SCAN, {});  // an empty result ends the list
        // Scanning interrupts connection attempts, so resume them
        if (!wifiConnected()) wifiConnectSaved();
    }
}

void improvLoop() {
    readSerial();
    checkProgress();
}

bool improvProvisioning() {
    return busy == CONNECTING;
}
